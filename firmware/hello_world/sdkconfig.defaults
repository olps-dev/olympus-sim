## firmware/hello_world/sdkconfig.defaults
```kconfig
# ESP32 QEMU Configuration
CONFIG_IDF_TARGET="esp32"
CONFIG_ESP32_DEFAULT_CPU_FREQ_240=y
CONFIG_ESP32_DEFAULT_CPU_FREQ_MHZ=240

# Enable logging
CONFIG_LOG_DEFAULT_LEVEL_INFO=y
CONFIG_LOG_MAXIMUM_LEVEL_VERBOSE=y

# QEMU specific settings
CONFIG_ESP_SYSTEM_PANIC_PRINT_HALT=y
CONFIG_ESP_MAIN_TASK_STACK_SIZE=8192 
```

## firmware/sdkconfig.defaults
```kconfig
# ESP32 Configuration
CONFIG_IDF_TARGET="esp32"
CONFIG_IDF_TARGET_ESP32=y

# Serial flasher config
CONFIG_ESPTOOLPY_FLASHSIZE_4MB=y

# Compiler options
CONFIG_COMPILER_OPTIMIZATION_SIZE=y

# Log output
CONFIG_LOG_DEFAULT_LEVEL_INFO=y
CONFIG_LOG_MAXIMUM_LEVEL_VERBOSE=y

# FreeRTOS
CONFIG_FREERTOS_HZ=1000

# UART Configuration
CONFIG_ESP_CONSOLE_UART_DEFAULT=y
CONFIG_ESP_CONSOLE_UART_NUM=0
CONFIG_ESP_CONSOLE_UART_BAUDRATE=115200

# Component config
CONFIG_ESP_SYSTEM_EVENT_TASK_STACK_SIZE=4096 
```
